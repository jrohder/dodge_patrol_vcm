#include "web/web_server.h"
#include "web/web_auth.h"

#include <ArduinoJson.h>
#include <cstring>

#include "config/config_registry.h"
#include "control/control_arbiter.h"
#include "control/steering_types.h"
#include "core/version.h"
#include "services/logger.h"
#include "services/safety.h"
#include "services/steering_recorder.h"
#include "services/telemetry.h"
#include "web_assets.h"  // generated by tools/embed_web.py

namespace vcm {

VcmWebServer webServer;

void VcmWebServer::begin() {
  webAuth.begin();
  webAuth.attach(server_);
  setupStatic();
  setupApi();
  setupOtaApi();
  setupSteeringApi();
  setupWebSocket();
  server_.onNotFound([](AsyncWebServerRequest* req) {
    const String url = req->url();
    const String host = req->host();
    if (url.indexOf("hotspot-detect") >= 0 || url.indexOf("success.html") >= 0 ||
        host.indexOf("apple") >= 0 || host.indexOf("captive") >= 0) {
      req->send(200, "text/html",
                "<HTML><HEAD><TITLE>Success</TITLE></HEAD><BODY>Success</BODY></HTML>");
      return;
    }
    if (url.indexOf("generate_204") >= 0) {
      req->send(204);
      return;
    }
    req->send(404, "text/plain", "Not found");
  });
  server_.begin();
  LOGI("WEB", "Web server started on port 80");
}

static void sendGz(AsyncWebServerRequest* req, const char* type,
                   const uint8_t* data, size_t len) {
  AsyncWebServerResponse* res = req->beginResponse(200, type, data, len);
  res->addHeader("Content-Encoding", "gzip");
  res->addHeader("Cache-Control", "no-cache");
  req->send(res);
}

void VcmWebServer::setupStatic() {
  server_.on("/", HTTP_GET, [](AsyncWebServerRequest* req) {
    sendGz(req, "text/html", WEB_INDEX_HTML_GZ, WEB_INDEX_HTML_GZ_LEN);
  });
  server_.on("/app.css", HTTP_GET, [](AsyncWebServerRequest* req) {
    sendGz(req, "text/css", WEB_APP_CSS_GZ, WEB_APP_CSS_GZ_LEN);
  });
  server_.on("/app.js", HTTP_GET, [](AsyncWebServerRequest* req) {
    sendGz(req, "application/javascript", WEB_APP_JS_GZ, WEB_APP_JS_GZ_LEN);
  });
}

// ------------------------------------------------------------- WebSocket

void VcmWebServer::setupWebSocket() {
  ws_.onEvent([this](AsyncWebSocket*, AsyncWebSocketClient* client,
                     AwsEventType type, void* arg, uint8_t* data, size_t len) {
    switch (type) {
      case WS_EVT_CONNECT:
        LOGI("WEB", "WS client #%lu connected (%s)",
             (unsigned long)client->id(),
             client->remoteIP().toString().c_str());
        break;
      case WS_EVT_DISCONNECT:
        LOGI("WEB", "WS client #%lu disconnected", (unsigned long)client->id());
        sdiagSubscribe(client->id(), false);
        if (ws_.count() == 0) arbiter.setWebControlRequested(false);
        break;
      case WS_EVT_DATA: {
        const AwsFrameInfo* info = (AwsFrameInfo*)arg;
        if (info->final && info->index == 0 && info->len == len &&
            info->opcode == WS_TEXT) {
          handleWsMessage(client, (const char*)data, len);
        }
        break;
      }
      default:
        break;
    }
  });
  server_.addHandler(&ws_);
}

void VcmWebServer::handleWsMessage(AsyncWebSocketClient* client,
                                   const char* data, size_t len) {
  JsonDocument doc;
  if (deserializeJson(doc, data, len) != DeserializationError::Ok) return;
  const char* type = doc["type"] | "";

  if (strcmp(type, "ctrl") == 0) {
    // Continuous driving command + heartbeat from the web remote
    arbiter.submitWebCommand(doc["t"] | 0.0f, doc["s"] | 0.0f,
                             doc["brake"] | false, doc["lights"] | false,
                             doc["siren"] | false);
  } else if (strcmp(type, "take") == 0) {
    arbiter.setWebControlRequested(true);
    arbiter.webHeartbeat();
  } else if (strcmp(type, "release") == 0) {
    arbiter.setWebControlRequested(false);
    arbiter.submitWebCommand(0, 0, true, false, false);
  } else if (strcmp(type, "estop") == 0) {
    safety.estop("web dashboard");
  } else if (strcmp(type, "estop_clear") == 0) {
    safety.clearEstop();
  } else if (strcmp(type, "pause") == 0) {
    telemetryPaused_ = doc["paused"] | false;
    LOGI("WEB", "Telemetry %s", telemetryPaused_ ? "paused" : "resumed");
  } else if (strcmp(type, "ping") == 0) {
    client->text("{\"type\":\"pong\"}");
  } else if (strcmp(type, "sdiag") == 0) {
    sdiagSubscribe(client->id(), doc["on"] | false);
  }
}

String VcmWebServer::buildTelemetryJson() {
  const VehicleTelemetry t = telemetry.snapshot();
  JsonDocument doc;
  doc["type"] = "telemetry";
  doc["ms"] = millis();

  JsonObject sys = doc["sys"].to<JsonObject>();
  sys["state"] = vehicleStateName(t.system.state);
  sys["src"] = controlSourceName(t.system.controlSource);
  sys["up"] = t.system.uptimeS;
  sys["heap"] = t.system.freeHeap;
  sys["minheap"] = t.system.minFreeHeap;
  sys["cpu"] = serialized(String(t.system.cpuLoadPct, 0));
  sys["rssi"] = t.system.wifiRssi;
  sys["comm"] = t.system.commissioned;
  sys["faults"] = t.system.activeFaultMask;
  sys["dyn_avg"] = t.system.dynAvgUs;
  sys["dyn_max"] = t.system.dynMaxUs;
  sys["dyn_miss"] = t.system.dynMisses;
  sys["str_avg"] = t.system.steerAvgUs;
  sys["str_max"] = t.system.steerMaxUs;
  sys["str_miss"] = t.system.steerMisses;
  sys["units"] = config.i(UI_UNITS);  // 0=IMPERIAL, 1=METRIC

  JsonObject drv = doc["drv"].to<JsonObject>();
  drv["thr"] = serialized(String(t.drive.throttleInput, 2));
  drv["spd"] = serialized(String(t.drive.vehicleSpeed, 2));
  drv["req"] = serialized(String(t.drive.requestedSpeed, 2));
  drv["lim"] = serialized(String(t.drive.limitedSpeed, 2));
  drv["lt"] = serialized(String(t.drive.leftTargetSpeed, 2));
  drv["rt"] = serialized(String(t.drive.rightTargetSpeed, 2));
  drv["la"] = serialized(String(t.drive.leftActualSpeed, 2));
  drv["ra"] = serialized(String(t.drive.rightActualSpeed, 2));
  drv["lrpm"] = serialized(String(t.drive.leftRpm, 0));
  drv["rrpm"] = serialized(String(t.drive.rightRpm, 0));
  drv["lpwm"] = serialized(String(t.drive.leftPwmPct, 1));
  drv["rpwm"] = serialized(String(t.drive.rightPwmPct, 1));
  drv["odo"] = serialized(String(t.drive.odometerM, 1));
  drv["trip"] = serialized(String(t.drive.tripM, 1));
  drv["bias"] = serialized(String(t.drive.differentialBias, 2));
  drv["slip"] = t.drive.slipDetected;

  JsonObject str = doc["str"].to<JsonObject>();
  str["req"] = serialized(String(t.steering.requestedPct, 1));
  str["act"] = serialized(String(t.steering.actualPct, 1));
  str["reqa"] = serialized(String(t.steering.requestedAngleDeg, 1));
  str["acta"] = serialized(String(t.steering.actualAngleDeg, 1));
  str["err"] = serialized(String(t.steering.error, 2));
  str["p"] = serialized(String(t.steering.pTerm, 2));
  str["i"] = serialized(String(t.steering.iTerm, 2));
  str["d"] = serialized(String(t.steering.dTerm, 2));
  str["out"] = serialized(String(t.steering.output, 1));
  str["pwm"] = serialized(String(t.steering.pwmPct, 1));
  str["raw"] = t.steering.feedbackRaw;
  str["filt"] = serialized(String(t.steering.feedbackFiltered, 0));
  str["wraw"] = t.steering.wheelInputRaw;
  str["wpct"] = serialized(String(t.steering.wheelInputPct, 1));
  str["cur"] = serialized(String(t.steering.currentA, 2));
  str["cvalid"] = t.steering.currentValid;
  str["cal"] = t.steering.calibrated;
  str["vel"] = serialized(String(t.steering.velocityPctS, 2));
  str["ff"] = serialized(String(t.steering.feedforward, 2));
  str["st"] = steerControlStateName((SteerControlState)t.steering.controlState);
  str["en"] = t.steering.outputEnabled;
  int pr = 0, ec = 0;
  bool hun = false;
  uint8_t sev = 0;
  steerDiag.computeHunting(pr, ec, hun, sev);
  str["hunt"] = hun;
  str["hunt_sev"] = sev;
  str["pwmrev"] = pr;

  JsonObject nan = doc["nano"].to<JsonObject>();
  nan["online"] = t.nano.online;
  JsonArray rc = nan["rc"].to<JsonArray>();
  for (int i = 0; i < 6; ++i) rc.add(t.nano.rcUs[i]);
  nan["rcv"] = t.nano.rcValid;
  nan["rct"] = serialized(String(t.nano.rcThrottle, 2));
  nan["rcs"] = serialized(String(t.nano.rcSteering, 2));
  nan["rcm"] = t.nano.rcValidMask;
  nan["lf"] = serialized(String(t.nano.leftFreqHz, 1));
  nan["rf"] = serialized(String(t.nano.rightFreqHz, 1));
  nan["lp"] = t.nano.leftPeriodUs;
  nan["rp"] = t.nano.rightPeriodUs;
  nan["ld"] = t.nano.leftDir;
  nan["rd"] = t.nano.rightDir;
  nan["lc"] = t.nano.leftPulseCount;
  nan["rc2"] = t.nano.rightPulseCount;
  nan["lwf"] = t.nano.leftWheelFault;
  nan["rwf"] = t.nano.rightWheelFault;
  JsonArray adc = nan["adc"].to<JsonArray>();
  for (int i = 0; i < 6; ++i) adc.add(t.nano.adc[i]);
  nan["out"] = t.nano.outputState;
  nan["nstate"] = t.nano.systemState;
  nan["ff"] = t.nano.faultBits;
  nan["rx"] = t.nano.packetsReceived;
  nan["tel"] = t.nano.telemetryReceived;
  nan["lost"] = t.nano.packetsLost;
  nan["crc"] = t.nano.crcErrors;
  nan["ferr"] = t.nano.frameErrors;
  nan["seq"] = t.nano.seqErrors;
  nan["acks"] = t.nano.acksReceived;
  nan["flts"] = t.nano.faultsReceived;
  nan["wdg"] = t.nano.watchdogResets;
  nan["ncrc"] = t.nano.nanoRxCrcErrors;
  nan["nferr"] = t.nano.nanoFrameErrors;
  nan["nloop"] = t.nano.nanoLoopMaxUs;
  nan["nlavg"] = t.nano.nanoLoopAvgUs;
  nan["ncpu"] = t.nano.nanoCpuPct;
  nan["nsub"] = t.nano.nanoSubsystems;
  nan["nsched"] = t.nano.nanoSchedulerOverruns;
  nan["nsamp"] = t.nano.nanoSamplerOverruns;
  nan["ntxd"] = t.nano.nanoTxDrops;
  nan["ncmd"] = t.nano.nanoCommandsReceived;
  nan["nglitch"] = t.nano.nanoRcGlitches;
  nan["nram"] = t.nano.nanoFreeRam;
  nan["nup"] = t.nano.nanoUptimeMs / 1000;
  nan["boot"] = t.nano.bootReason;
  nan["jit"] = serialized(String(t.nano.jitterUs, 0));
  nan["ts"] = t.nano.timestampUs;
  nan["rate"] = serialized(String(t.nano.packetRateHz, 1));
  nan["age"] = t.nano.lastPacketMs ? (millis() - t.nano.lastPacketMs) : -1;
  nan["hbage"] =
      t.nano.lastHeartbeatMs ? (millis() - t.nano.lastHeartbeatMs) : -1;
  nan["proto"] = t.nano.protocolVersion;
  nan["fw"] = String(t.nano.nanoFwMajor) + "." + String(t.nano.nanoFwMinor) +
              "." + String(t.nano.nanoFwPatch);
  nan["hver"] = t.nano.haveVersion;
  nan["hdiag"] = t.nano.haveDiagnostic;

  JsonObject pwr = doc["pwr"].to<JsonObject>();
  pwr["v"] = serialized(String(t.power.busVoltage, 2));
  pwr["li"] = serialized(String(t.power.leftCurrentA, 2));
  pwr["ri"] = serialized(String(t.power.rightCurrentA, 2));
  pwr["si"] = serialized(String(t.power.steeringCurrentA, 2));
  pwr["peak"] = serialized(String(t.power.peakCurrentA, 2));
  pwr["health"] = sensorHealthName(t.power.inaHealth);

  JsonObject imu = doc["imu"].to<JsonObject>();
  JsonArray ra = imu["raw_a"].to<JsonArray>();
  JsonArray rg = imu["raw_g"].to<JsonArray>();
  JsonArray ca = imu["a"].to<JsonArray>();
  JsonArray cg = imu["g"].to<JsonArray>();
  for (int i = 0; i < 3; ++i) {
    ra.add(serialized(String(t.imu.rawAccel[i], 3)));
    rg.add(serialized(String(t.imu.rawGyro[i], 2)));
    ca.add(serialized(String(t.imu.accel[i], 3)));
    cg.add(serialized(String(t.imu.gyro[i], 2)));
  }
  imu["pitch"] = serialized(String(t.imu.pitchDeg, 1));
  imu["roll"] = serialized(String(t.imu.rollDeg, 1));
  imu["yaw"] = serialized(String(t.imu.yawRateDps, 1));
  imu["temp"] = serialized(String(t.imu.tempC, 1));
  imu["health"] = sensorHealthName(t.imu.health);

  String out;
  serializeJson(doc, out);
  return out;
}

void VcmWebServer::broadcastTelemetry() {
  if (telemetryPaused_ || ws_.count() == 0) return;
  ws_.textAll(buildTelemetryJson());
}

void VcmWebServer::sdiagSubscribe(uint32_t clientId, bool on) {
  for (uint8_t i = 0; i < sdiagCount_; ++i) {
    if (sdiagIds_[i] == clientId) {
      if (!on) {
        sdiagIds_[i] = sdiagIds_[sdiagCount_ - 1];
        sdiagSeq_[i] = sdiagSeq_[sdiagCount_ - 1];
        sdiagCount_--;
      }
      return;
    }
  }
  if (on && sdiagCount_ < kMaxSdiagClients) {
    sdiagIds_[sdiagCount_] = clientId;
    sdiagSeq_[sdiagCount_] = 0;  // live from now; snapshot is HTTP
    sdiagCount_++;
    LOGI("WEB", "Steering diag stream on for client #%lu",
         (unsigned long)clientId);
  }
}

void VcmWebServer::broadcastSteerDiag() {
  if (sdiagCount_ == 0) return;
  static constexpr uint16_t kBatch = 40;
  uint8_t packet[12 + kBatch * sizeof(SteeringDiagPacked)];
  auto* payload = reinterpret_cast<SteeringDiagPacked*>(packet + 12);

  for (int i = (int)sdiagCount_ - 1; i >= 0; --i) {
    AsyncWebSocketClient* client = ws_.client(sdiagIds_[i]);
    if (!client || client->status() != WS_CONNECTED) {
      sdiagSubscribe(sdiagIds_[i], false);
      continue;
    }
    if (!client->canSend()) continue;
    if (client->queueIsFull()) continue;
    uint32_t last = sdiagSeq_[i];
    const size_t n =
        steerDiag.copySince(sdiagSeq_[i], payload, kBatch, last);
    if (n == 0) continue;
    packet[0] = 'S';
    packet[1] = 'D';
    packet[2] = 1;
    packet[3] = 0;
    packet[4] = (uint8_t)(n & 0xFF);
    packet[5] = (uint8_t)((n >> 8) & 0xFF);
    memcpy(packet + 6, &last, 4);
    packet[10] = packet[11] = 0;
    client->binary(packet, 12 + n * sizeof(SteeringDiagPacked));
    sdiagSeq_[i] = last;
  }
}

void VcmWebServer::tick() { ws_.cleanupClients(); }

}  // namespace vcm
